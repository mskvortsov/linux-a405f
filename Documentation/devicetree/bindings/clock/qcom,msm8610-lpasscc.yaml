## Documentation/devicetree/bindings/clock/qcom,msm8610-lpasscc.yaml
```yaml
# SPDX-License-Identifier: (GPL-2.0-only OR BSD-2-Clause)
%YAML 1.2
---
$id: http://devicetree.org/schemas/clock/qcom,msm8610-lpasscc.yaml#
$schema: http://devicetree.org/meta-schemas/core.yaml#

title: Qualcomm LPASS Clock Controller on MSM8610

maintainers:
  - Mikhael Skvortsov <mikhael.skvortsov@gmail.com>

description: |
  Qualcomm LPASS clock controller provides the clocks of the internal
  digital audio codec on MSM8610. The other LPASS clocks are managed by the
  ADSP firmware.

  See also:
    include/dt-bindings/clock/qcom,msm8610-lpasscc.h

properties:
  compatible:
    const: qcom,msm8610-lpasscc

  reg:
    maxItems: 1

  clocks:
    items:
      - description: Board XO source

  clock-names:
    items:
      - const: xo

  '#clock-cells':
    const: 1

required:
  - compatible
  - reg
  - clocks
  - clock-names
  - '#clock-cells'

additionalProperties: false

examples:
  - |
    clock-controller@fe000000 {
        compatible = "qcom,msm8610-lpasscc";
        reg = <0xfe000000 0x40000>;
        clocks = <&xo_board>;
        clock-names = "xo";
        #clock-cells = <1>;
    };
...
```

## Documentation/devicetree/bindings/display/panel/samsung,s6e8fc0-a40.yaml
```yaml
# SPDX-License-Identifier: GPL-2.0-only OR BSD-2-Clause
%YAML 1.2
---
$id: http://devicetree.org/schemas/display/panel/samsung,s6e8fc0-a40.yaml#
$schema: http://devicetree.org/meta-schemas/core.yaml#

title: Samsung Galaxy A40 S6E8FC0 1080x2340 AMOLED panel

maintainers:
  - Dzmitry Sankouski <dsankouski@gmail.com>

description:
  Samsung S6E8FC0 AMOLED panel variant found in the Samsung Galaxy A40.
  It is a 5.9 inch 1080x2340 MIPI-DSI video mode panel.

allOf:
  - $ref: panel-common.yaml#

properties:
  compatible:
    const: samsung,s6e8fc0-a40

  reg:
    maxItems: 1

  reset-gpios: true

  vdd3p0-supply:
    description: 3.0V panel source voltage rail

  port: true

required:
  - compatible
  - reg
  - reset-gpios
  - vdd3p0-supply
  - port

additionalProperties: false

examples:
  - |
    #include <dt-bindings/gpio/gpio.h>

    dsi {
        #address-cells = <1>;
        #size-cells = <0>;

        panel@0 {
            compatible = "samsung,s6e8fc0-a40";
            reg = <0>;

            vdd3p0-supply = <&panel_3p0>;
            reset-gpios = <&gpg2 0 GPIO_ACTIVE_HIGH>;

            port {
                panel_in: endpoint {
                    remote-endpoint = <&dsi_out>;
                };
            };
        };
    };

...
```

## Documentation/devicetree/bindings/pinctrl/qcom,msm8610-tlmm.yaml
```yaml
# SPDX-License-Identifier: (GPL-2.0-only OR BSD-2-Clause)
%YAML 1.2
---
$id: http://devicetree.org/schemas/pinctrl/qcom,msm8610-tlmm.yaml#
$schema: http://devicetree.org/meta-schemas/core.yaml#

title: Qualcomm Technologies, Inc. MSM8610 TLMM block

maintainers:
  - Mikhael Skvortsov <mikhael.skvortsov@gmail.com>

description: |
  Top Level Mode Multiplexer pin controller in Qualcomm MSM8610 SoC.

allOf:
  - $ref: /schemas/pinctrl/qcom,tlmm-common.yaml#

properties:
  compatible:
    const: qcom,msm8610-tlmm

  reg:
    maxItems: 1

  interrupts:
    maxItems: 1

  gpio-reserved-ranges: true

patternProperties:
  "-state$":
    oneOf:
      - $ref: "#/$defs/qcom-msm8610-tlmm-state"
      - patternProperties:
          "-pins$":
            $ref: "#/$defs/qcom-msm8610-tlmm-state"
        additionalProperties: false

$defs:
  qcom-msm8610-tlmm-state:
    type: object
    description:
      Pinctrl node's client devices use subnodes for desired pin configuration.
      Client device subnodes use below standard properties.
    $ref: qcom,tlmm-common.yaml#/$defs/qcom-tlmm-state
    unevaluatedProperties: false

    properties:
      pins:
        description:
          List of gpio pins affected by the properties specified in this
          subnode.
        items:
          oneOf:
            - pattern: "^gpio([0-9]|[1-9][0-9]|10[01])$"
            - enum: [ sdc1_clk, sdc1_cmd, sdc1_data, sdc2_clk, sdc2_cmd,
                      sdc2_data, cdc_i2c_scl, cdc_i2c_sda ]
        minItems: 1
        maxItems: 16

      function:
        description:
          Specify the alternative function to be configured for the specified
          pins.
        enum: [ blsp_i2c1, blsp_i2c2, blsp_i2c3, blsp_spi4, blsp_uart2,
                cam_mclk0, cam_mclk1, dmic0_clk, dmic0_data, gpio, wlan ]

    required:
      - pins

required:
  - compatible
  - reg

unevaluatedProperties: false

examples:
  - |
    #include <dt-bindings/interrupt-controller/arm-gic.h>

    tlmm: pinctrl@fd510000 {
        compatible = "qcom,msm8610-tlmm";
        reg = <0xfd510000 0x4000>;
        interrupts = <GIC_SPI 208 IRQ_TYPE_LEVEL_HIGH>;
        gpio-controller;
        #gpio-cells = <2>;
        gpio-ranges = <&tlmm 0 0 102>;
        interrupt-controller;
        #interrupt-cells = <2>;

        uart-w-subnodes-state {
            tx-pins {
                pins = "gpio4";
                function = "blsp_uart2";
                drive-strength = <2>;
                bias-disable;
            };

            rx-pins {
                pins = "gpio5";
                function = "blsp_uart2";
                drive-strength = <2>;
                bias-pull-up;
            };
        };
    };
...
```

## Documentation/devicetree/bindings/power/supply/qcom,pm8110-bms.yaml
```yaml
# SPDX-License-Identifier: (GPL-2.0-only OR BSD-2-Clause)
%YAML 1.2
---
$id: http://devicetree.org/schemas/power/supply/qcom,pm8110-bms.yaml#
$schema: http://devicetree.org/meta-schemas/core.yaml#

title: Qualcomm PM8110 Battery Monitoring System

maintainers:
  - Mikhael Skvortsov <mikhael.skvortsov@gmail.com>

description:
  The Battery Monitoring System (BMS) is a hardware block found in some
  Qualcomm PMICs such as PM8110. It measures the open circuit voltage of the
  battery while the system sleeps and counts the charge flowing through a
  sense resistor with its own current ADC, from which the state of charge is
  calculated.

allOf:
  - $ref: power-supply.yaml#

properties:
  compatible:
    const: qcom,pm8110-bms

  reg:
    items:
      - description: BMS registers
      - description: BMS current ADC registers

  io-channels:
    minItems: 4
    items:
      - description: Battery voltage
      - description: Voltage ADC 625 mV reference
      - description: Voltage ADC 1.25 V reference
      - description: Current ADC channel of the sense resistor, for its gain
      - description: Battery temperature

  io-channel-names:
    minItems: 4
    items:
      - const: vbat
      - const: ref_625mv
      - const: ref_1250mv
      - const: iadc
      - const: temp

  monitored-battery: true

  power-supplies: true

required:
  - compatible
  - reg
  - io-channels
  - io-channel-names
  - monitored-battery

additionalProperties: false

examples:
  - |
    #include <dt-bindings/iio/qcom,spmi-vadc.h>

    pmic {
      #address-cells = <1>;
      #size-cells = <0>;

      battery@4000 {
        compatible = "qcom,pm8110-bms";
        reg = <0x4000>, <0x3800>;
        io-channels = <&pm8110_vadc VADC_VBAT_SNS>,
                      <&pm8110_vadc VADC_REF_625MV>,
                      <&pm8110_vadc VADC_REF_1250MV>,
                      <&pm8110_iadc 0>,
                      <&battery_thermistor>;
        io-channel-names = "vbat",
                           "ref_625mv",
                           "ref_1250mv",
                           "iadc",
                           "temp";
        monitored-battery = <&battery>;
        power-supplies = <&pm8110_charger>;
      };
    };
```

## Documentation/devicetree/bindings/sound/qcom,msm8610-wcd.yaml
```yaml
# SPDX-License-Identifier: (GPL-2.0-only OR BSD-2-Clause)
%YAML 1.2
---
$id: http://devicetree.org/schemas/sound/qcom,msm8610-wcd.yaml#
$schema: http://devicetree.org/meta-schemas/core.yaml#

title: Qualcomm MSM8610 internal audio codec

maintainers:
  - Mikhael Skvortsov <mikhael.skvortsov@gmail.com>

description:
  The internal audio codec of the MSM8610 (MSM8x10) family of SoCs consists
  of an analog part with its own digital core, which is controlled over I2C
  at two slave addresses, and a digital part with the decimators and
  interpolators in the LPASS, which is memory mapped. The two parts are
  connected by a PDM interface, the digital part by I2S to the LPASS MI2S
  interfaces.

allOf:
  - $ref: dai-common.yaml#

properties:
  compatible:
    const: qcom,msm8610-wcd

  reg:
    items:
      - description: I2C address of the digital core of the analog part
      - description: I2C address of the analog part

  reg-names:
    items:
      - const: core
      - const: analog

  clocks:
    items:
      - description: Digital codec core clock
      - description: Digital codec register interface clock

  clock-names:
    items:
      - const: mclk
      - const: ahb

  qcom,digital-codec:
    $ref: /schemas/types.yaml#/definitions/phandle
    description: Syscon node with the registers of the digital part

  vdd-cp-supply:
    description: Charge pump supply

  vdda-h-supply:
    description: Analog supply

  vdd-px-supply:
    description: I/O supply

  vdd-1p2-supply:
    description: 1.2 V digital supply

  vdd-micbias-supply:
    description: Microphone bias supply

  '#sound-dai-cells':
    const: 1

required:
  - compatible
  - reg
  - reg-names
  - clocks
  - clock-names
  - qcom,digital-codec
  - vdd-cp-supply
  - vdda-h-supply
  - vdd-px-supply
  - vdd-1p2-supply
  - vdd-micbias-supply
  - '#sound-dai-cells'

unevaluatedProperties: false

examples:
  - |
    #include <dt-bindings/clock/qcom,msm8610-lpasscc.h>

    i2c {
        #address-cells = <1>;
        #size-cells = <0>;

        audio-codec@d {
            compatible = "qcom,msm8610-wcd";
            reg = <0x0d>, <0x77>;
            reg-names = "core", "analog";
            clocks = <&lpasscc DIGCODEC_CLK>,
                     <&lpasscc DIGCODEC_AHB_CLK>;
            clock-names = "mclk", "ahb";
            qcom,digital-codec = <&lpass_codec>;
            vdd-cp-supply = <&pm8110_s4>;
            vdda-h-supply = <&pm8110_l6>;
            vdd-px-supply = <&pm8110_l6>;
            vdd-1p2-supply = <&pm8110_l4>;
            vdd-micbias-supply = <&pm8110_l20>;
            #sound-dai-cells = <1>;
        };
    };
...
```

## drivers/misc/samsung/Kconfig
```kconfig
# SPDX-License-Identifier: GPL-2.0-only

source "drivers/misc/samsung/scsc/Kconfig"
source "drivers/misc/samsung/gnss_kepler/Kconfig"
```

## drivers/misc/samsung/cp_pmu_probe/Kconfig
```kconfig
# SPDX-License-Identifier: GPL-2.0-only

config CP_PMU_PROBE
	tristate "Samsung CP (modem) PMU-only bring-up probe"
	depends on (ARCH_EXYNOS && OF) || COMPILE_TEST
	help
	  Isolated PMU_ALIVE bring-up probe for the CP (Shannon SS310AP
	  modem) domain -- no mailbox, no firmware, no SMC, no SIPC. Exists
	  to answer one question: is CENTRAL_SEQ_CP_STATUS (PMU_ALIVE
	  0x0284) unreachable because nothing has ever issued the CP
	  domain's cal_cp_init() equivalent, or for some other reason? See
	  gnss.md in the tree root, "Downstream sources for CP init and
	  firmware load".

	  This is not a modem driver and never will be -- it does not touch
	  the CP mailbox's IPC channel, does not load firmware, and cannot
	  bring up the cellular stack. Say M here only if you are
	  live-probing this specific PMU question; the offsets it touches
	  have not been individually confirmed safe to read (see the
	  driver's own comments and gnss.md's warnings about hanging the
	  device from untested PMU_ALIVE offsets).
```

## drivers/misc/samsung/gnss_kepler/Kconfig
```kconfig
# SPDX-License-Identifier: GPL-2.0-only

config GNSS_KEPLER
	tristate "Samsung Kepler GNSS companion chip bring-up driver"
	depends on (ARCH_EXYNOS && OF) || COMPILE_TEST
	help
	  Bring-up driver for the Samsung "Kepler" GNSS companion chip
	  found on several Exynos-based Samsung phones.

	  Milestone 1: PMU_ALIVE power-on sequencing and fault-region
	  readback via debugfs only. No MCU_IPC mailbox protocol, no
	  BCMD, no firmware load yet -- see gnss.md in the tree root for
	  the downstream hardware investigation this is based on.

	  Say M here to build it as a module, so it can be reloaded
	  while bringing the chip up without rebuilding/reflashing the
	  kernel.
```

## drivers/misc/samsung/scsc/Kconfig
```kconfig
# SPDX-License-Identifier: GPL-2.0-only

config SCSC_MX
	tristate "Samsung SCSC Maxwell (WLBT) core driver"
	depends on (ARCH_EXYNOS && OF) || COMPILE_TEST
	depends on EXYNOS_ACPM_PROTOCOL
	depends on CFG80211
	depends on BT
	help
	  Core driver for the Samsung SCSC "Maxwell" WLBT companion chip
	  (WiFi/BT combo) found on several Exynos-based Samsung phones.

	  This manages the AP<->WLBT mailbox register windows and chip
	  power/reset sequencing via PMU_ALIVE, boots firmware onto the
	  chip, and carries the HIP4 transport and FAPI signal layer. It
	  registers a cfg80211 interface with scan, association, and a data
	  path, and a hci_dev with HCI command/event and ACL data over the
	  BSMHCP rings. WLAN and BT can run concurrently on this firmware
	  and both start by default.

	  Say M here to build it as a module, so it can be reloaded while
	  bringing the chip up without rebuilding/reflashing the kernel.
```
